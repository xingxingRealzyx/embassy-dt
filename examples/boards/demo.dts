/dts-v1/;
#include "demo.dtsi"

/ {
    model = "Host-Demo-Board";
    compatible = "embassy-dt,demo";

    bme280: bme@76 {
        compatible = "bosch,bme280";
        bus = <&i2c0>;
        addr = <0x76>;
    };
};
